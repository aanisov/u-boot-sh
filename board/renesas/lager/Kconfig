## board/renesas/lager/Kconfig
```kconfig
if TARGET_LAGER

config SYS_BOARD
	default "lager"

config SYS_VENDOR
	default "renesas"

config SYS_CONFIG_NAME
	default "lager"

config ARMV7_VIRT
	bool "Virtualization support"

endif
```
